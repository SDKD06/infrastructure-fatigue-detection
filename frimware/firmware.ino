/*
 * firmware.ino  -  Edge tier: real Isolation Forest on ESP32.
 *
 * Fixes vs. original:
 *   * reads a REAL accelerometer (MPU6050 example) instead of random()
 *   * extracts the SAME 30 vibration features as feature_utils.py, in the
 *     same order, using a 512-sample (2s @ 256Hz) window + FFT
 *   * runs the FAITHFUL Isolation Forest from micro_forest.h (not a heuristic)
 *   * vibration naming (not "acoustic/MFCC")
 *
 * Requires libraries: MPU6050 (or your sensor), arduinoFFT, WiFi, HTTPClient.
 *
 * PARITY NOTE: the offline pipeline removes DC per-recording; on-device we
 * remove DC per-window (subtract the window mean). This makes on-device RMS
 * ~= STD. It's a small, documented edge/cloud feature gap - validate scores
 * against Python on a few captured windows and report it in the paper.
 */

#include <WiFi.h>
#include <HTTPClient.h>
#include <Wire.h>
#include <arduinoFFT.h>
#include "micro_forest.h"   // generated by export_tinyml.py  (defines N_FEATURES=30)

// ── Config ───────────────────────────────────────────────────────────────────
const char* ssid      = "YOUR_WIFI_SSID";
const char* password  = "YOUR_WIFI_PASSWORD";
const char* serverUrl = "http://192.168.1.50:8501/api/v1/telemetry";

const int   ALERT_LED_PIN = 2;
const int   FS            = 256;     // must equal TARGET_FS in feature_utils.py
const int   WIN           = 512;     // 2s window, power of two
const int   N_AXES        = 3;
const int   MPU_ADDR      = 0x68;

double vReal[WIN];
double vImag[WIN];
ArduinoFFT<double> FFT = ArduinoFFT<double>(vReal, vImag, WIN, (double)FS);

float window_buf[WIN][N_AXES];
float features[N_FEATURES];

// ── Sensor (MPU6050). Swap this for your accelerometer if different. ─────────
void mpu_init() {
  Wire.begin();
  Wire.beginTransmission(MPU_ADDR);
  Wire.write(0x6B); Wire.write(0);   // wake up
  Wire.endTransmission(true);
}

void mpu_read(float* ax, float* ay, float* az) {
  Wire.beginTransmission(MPU_ADDR);
  Wire.write(0x3B);
  Wire.endTransmission(false);
  Wire.requestFrom(MPU_ADDR, 6, true);
  int16_t rx = (Wire.read() << 8) | Wire.read();
  int16_t ry = (Wire.read() << 8) | Wire.read();
  int16_t rz = (Wire.read() << 8) | Wire.read();
  const float S = 16384.0f;          // LSB/g at +/-2g
  const float G = 9.80665f;
  *ax = rx / S * G; *ay = ry / S * G; *az = rz / S * G;  // m/s^2 (matches dataset units)
}

// ── Collect one 512-sample window at FS ─────────────────────────────────────
void capture_window() {
  const unsigned long period_us = 1000000UL / FS;
  for (int i = 0; i < WIN; i++) {
    unsigned long t0 = micros();
    mpu_read(&window_buf[i][0], &window_buf[i][1], &window_buf[i][2]);
    while (micros() - t0 < period_us) { /* hold sample rate */ }
  }
}

// ── Per-axis 10 features, SAME ORDER as feature_utils.py ─────────────────────
// [rms, std, kurt(excess,biased), skew(biased), p2p,
//  dom_freq, spec_energy, spec_centroid, spec_entropy, crest_factor]
void extract_axis_features(int axis, int out_offset) {
  // 1) load axis, subtract per-window mean (DC/gravity removal)
  double mean = 0;
  for (int i = 0; i < WIN; i++) mean += window_buf[i][axis];
  mean /= WIN;

  double sumsq_raw = 0, m2 = 0, m3 = 0, m4 = 0, maxabs = 0, vmin = 1e9, vmax = -1e9;
  for (int i = 0; i < WIN; i++) {
    double raw = window_buf[i][axis];
    double c   = raw - mean;
    sumsq_raw += raw * raw;
    m2 += c * c; m3 += c * c * c; m4 += c * c * c * c;
    if (fabs(raw) > maxabs) maxabs = fabs(raw);
    if (raw < vmin) vmin = raw;
    if (raw > vmax) vmax = raw;
    vReal[i] = c;            // FFT on zero-centred signal (numpy uses raw window)
    vImag[i] = 0.0;
  }
  double rms = sqrt(sumsq_raw / WIN);
  m2 /= WIN; m3 /= WIN; m4 /= WIN;
  double sd   = sqrt(m2);
  double skew = (m2 > 0) ? m3 / pow(m2, 1.5) : 0.0;
  double kurt = (m2 > 0) ? m4 / (m2 * m2) - 3.0 : 0.0;   // Fisher, biased (scipy default)
  double p2p  = vmax - vmin;

  // 2) FFT (NO windowing, to match numpy.rfft)
  FFT.compute(FFTDirection::Forward);
  FFT.complexToMagnitude();           // magnitude now in vReal[0 .. WIN/2]
  int nbins = WIN / 2 + 1;

  double sum_mag = 0, sum_fmag = 0, spec_energy = 0, psum = 0;
  int peak = 0; double peakval = -1;
  for (int b = 0; b < nbins; b++) {
    double mag = vReal[b];
    double freq = (double)b * FS / WIN;
    sum_mag  += mag;
    sum_fmag += freq * mag;
    spec_energy += mag * mag;
    psum += mag * mag;
    if (mag > peakval) { peakval = mag; peak = b; }
  }
  double dom_freq = (double)peak * FS / WIN;
  double centroid = (sum_mag > 0) ? sum_fmag / sum_mag : 0.0;
  double entropy = 0;
  for (int b = 0; b < nbins; b++) {
    double p = (vReal[b] * vReal[b]) / (psum + 1e-10);
    entropy -= p * log(p + 1e-10);
  }
  double crest = maxabs / (rms + 1e-10);

  features[out_offset + 0] = (float)rms;
  features[out_offset + 1] = (float)sd;
  features[out_offset + 2] = (float)kurt;
  features[out_offset + 3] = (float)skew;
  features[out_offset + 4] = (float)p2p;
  features[out_offset + 5] = (float)dom_freq;
  features[out_offset + 6] = (float)spec_energy;
  features[out_offset + 7] = (float)centroid;
  features[out_offset + 8] = (float)entropy;
  features[out_offset + 9] = (float)crest;
}

void compute_features() {
  for (int axis = 0; axis < N_AXES; axis++)
    extract_axis_features(axis, axis * 10);
}

// ── Cloud uplink (unchanged contract, vibration naming) ─────────────────────
void send_alert(float score) {
  if (WiFi.status() != WL_CONNECTED) {
    Serial.println(" | cloud sync failed: WiFi down"); return;
  }
  HTTPClient http;
  http.begin(serverUrl);
  http.addHeader("Content-Type", "application/json");
  String body = "{\"score\":" + String(score, 6) + ",\"node\":\"Node_01\",\"features\":[";
  for (int i = 0; i < N_FEATURES; i++) {
    body += String(features[i], 6);
    if (i < N_FEATURES - 1) body += ",";
  }
  body += "]}";
  int code = http.POST(body);
  Serial.print(" | cloud HTTP "); Serial.println(code);
  http.end();
}

void setup() {
  Serial.begin(115200);
  pinMode(ALERT_LED_PIN, OUTPUT);
  mpu_init();
  WiFi.begin(ssid, password);
  Serial.print("WiFi");
  while (WiFi.status() != WL_CONNECTED) { delay(400); Serial.print("."); }
  Serial.println(" connected. Edge IF ready.");
}

void loop() {
  capture_window();
  compute_features();

  float score = 0.0f;
  bool anomaly = predict_anomaly(features, &score);   // faithful IF from header

  Serial.print("score="); Serial.print(score, 6);
  if (anomaly) {
    Serial.println("  [ANOMALY]");
    digitalWrite(ALERT_LED_PIN, HIGH);
    send_alert(score);
  } else {
    Serial.println("  [normal]");
    digitalWrite(ALERT_LED_PIN, LOW);
  }
}
